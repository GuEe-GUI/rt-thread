## components/drivers/adc/Kconfig
```kconfig
menuconfig RT_USING_ADC
    bool "Using ADC device drivers"
    default n

config RT_ADC_ROCKCHIP_SARADC
    bool "Rockchip SARADC driver"
    depends on RT_USING_DM
    depends on RT_USING_ADC
    select RT_USING_RESET
    select RT_USING_REGULATOR
    default n

config RT_ADC_RP1
    bool "RP1 ADC and temperature sensor driver"
    depends on RT_USING_DM
    depends on RT_USING_ADC
    select RT_USING_REGULATOR
    default n
```

## components/drivers/audio/rockchip/Kconfig
```kconfig
menuconfig RT_AUDIO_ROCKCHIP
    bool "Enable Rockchip Audio"
    select RT_USING_OFW
    default n

config RT_AUDIO_ROCKCHIP_I2S
    bool "Rockchip I2S Device Driver"
    depends on RT_AUDIO_ROCKCHIP
    default n

config RT_AUDIO_ROCKCHIP_I2S_TDM
    bool "Rockchip I2S/TDM Device Driver"
    depends on RT_AUDIO_ROCKCHIP
    default n

config RT_AUDIO_ROCKCHIP_HEADSET
    bool "Rockchips HeadSet support"
    depends on RT_AUDIO_ROCKCHIP
    default n

config RT_AUDIO_ROCKCHIP_PDM
    bool "Rockchip PDM Controller Driver"
    depends on RT_AUDIO_ROCKCHIP
    default n

config RT_AUDIO_ROCKCHIP_SPDIF
    bool "Rockchip SPDIF Controller Driver"
    depends on RT_AUDIO_ROCKCHIP
    default n
```

## components/drivers/block/Kconfig
```kconfig
menuconfig RT_USING_BLK
    bool "Using Block device drivers"
    depends on RT_USING_DM
    default n

if RT_USING_BLK
source "$RTT_DIR/components/drivers/block/partitions/Kconfig"
endif
```

## components/drivers/block/partitions/Kconfig
```kconfig
menu "Partition Types"

config RT_BLK_PARTITION_DFS
    bool "DFS Partition support"
    default y

config RT_BLK_PARTITION_EFI
    bool "EFI Globally Unique Identifier (GUID) Partition support"
    default y

endmenu
```

## components/drivers/can/Kconfig
```kconfig
menuconfig RT_USING_CAN
    bool "Using CAN device drivers"
    default n

if RT_USING_CAN
    config RT_CAN_USING_HDR
        bool "Enable CAN hardware filter"
        default n
    config RT_CAN_USING_CANFD
        bool "Enable CANFD support"
        default n
endif

config RT_CAN_CANFD_ROCKCHIP
    bool "Rockchip CANFD controller"
    depends on RT_USING_DM
    depends on RT_USING_CAN
    depends on RT_CAN_USING_CANFD
    select RT_USING_RESET
    default n
```

## components/drivers/clk/Kconfig
```kconfig
menuconfig RT_USING_CLK
    bool "Using Common Clock Framework (CLK)"
    depends on RT_USING_DM
    default n
```

## components/drivers/clk/rockchip/Kconfig
```kconfig
menuconfig RT_CLK_ROCKCHIP_RK8XX_CLKOUT
    bool "Clock driver for RK805/RK808/RK809/RK817/RK818"
    depends on RT_MFD_RK8XX
    select RT_USING_OFW
    default n

menuconfig RT_CLK_ROCKCHIP
    bool "Rockchip clock controller common"
    select RT_USING_OFW
    select RT_USING_RESET
    default n

config RT_CLK_ROCKCHIP_RK3308
    bool "Rockchip RK3308 clock controller support"
    depends on RT_CLK_ROCKCHIP
    default n

config RT_CLK_ROCKCHIP_RK3568
    bool "Rockchip RK3568 clock controller support"
    depends on RT_CLK_ROCKCHIP
    default n
```

## components/drivers/firmware/Kconfig
```kconfig
menuconfig RT_USING_FIRMWARE
    bool "Using Firmware"
    depends on RT_USING_DM
    default n

config RT_FIRMWARE_PSCI
    bool "Power State Coordination Interface (PSCI)"
    depends on RT_USING_FIRMWARE
    depends on RT_USING_OFW
    default n

config RT_FIRMWARE_QEMU_FW_CFG
    bool "QEMU Firmware Configuration"
    depends on RT_USING_FIRMWARE
    select RT_USING_DFS
    select RT_USING_DFS_DIRECTFS
    default n
```

## components/drivers/firmware/arm_scmi/Kconfig
```kconfig
menuconfig RT_FIRMWARE_ARM_SCMI
    bool "ARM System Control and Management Interface Protocol (SCMI)"
    depends on RT_USING_FIRMWARE
    depends on ARCH_ARM_CORTEX_A || ARCH_ARMV8
    select RT_USING_OFW
    default n

config RT_FIRMWARE_ARM_SCMI_TRANSPORT_SMC
    bool "SCMI transport based on SMC"
    depends on RT_FIRMWARE_ARM_SCMI
    default y
```

## components/drivers/hwspinlock/Kconfig
```kconfig
menuconfig RT_USING_HWSPINLOCK
    bool "Using Hardware Spinlock device drivers"
    depends on RT_USING_DM
    select RT_USING_OFW
    select RT_USING_ADT_REF
    default n
    help
      Hardware spinlock modules provide hardware assistance for
      synchronization and mutual exclusion between heterogeneous processors
      and those not operating under a single, shared operating system.

config RT_HWSPINLOCK_ROCKCHIP
    bool "Rockchip Hardware Spinlock device"
    depends on RT_USING_HWSPINLOCK
    default n
```

## components/drivers/hwtimer/Kconfig
```kconfig
menuconfig RT_USING_HWTIMER
    bool "Using Hardware Timer device drivers"
    default n
```

## components/drivers/i2c/Kconfig
```kconfig
menuconfig RT_USING_I2C
    bool "Using I2C device drivers"
    default n

if RT_USING_I2C
    config RT_I2C_DEBUG
        bool "Use I2C debug message"
        default n

    config RT_USING_I2C_BITOPS
        bool "Use GPIO to simulate I2C"
        default y

    if RT_USING_I2C_BITOPS
        config RT_I2C_BITOPS_DEBUG
            bool "Use simulate I2C debug message"
            default n
    endif
endif

config RT_I2C_RK3X
    bool "Rockchip RK3xxx I2C adapter"
    depends on RT_USING_DM
    depends on RT_USING_I2C
    select RT_MFD_SYSCON
    select RT_USING_PINCTRL
    default n
```

## components/drivers/input/Kconfig
```kconfig
menuconfig RT_USING_INPUT
    bool "Using Input device drivers"
    depends on RT_USING_DM
    default n

if RT_USING_INPUT
source "$RTT_DIR/components/drivers/input/keyboard/Kconfig"
source "$RTT_DIR/components/drivers/input/misc/Kconfig"
source "$RTT_DIR/components/drivers/input/touchscreen/Kconfig"
endif
```

## components/drivers/input/keyboard/Kconfig
```kconfig
menuconfig RT_INPUT_KEYBOARD
    bool "Keyboards"
    default n

config RT_INPUT_KEYBOARD_ADC_KEYS
    bool "ADC Ladder Buttons"
    depends on RT_INPUT_KEYBOARD
    select RT_USING_OFW
    select RT_USING_ADC
    default n

config RT_INPUT_KEYBOARD_GPIO_KEYS
    bool "GPIO"
    depends on RT_INPUT_KEYBOARD
    select RT_USING_OFW
    default n
```

## components/drivers/input/misc/Kconfig
```kconfig
menuconfig RT_INPUT_MISC
    bool "Misc"
    default n

config RT_INPUT_MISC_E3X0_BUTTON
    bool "NI Ettus Research USRP E3xx Button support"
    depends on RT_INPUT_MISC
    default n

config RT_INPUT_MISC_RK8XX_PWRKEY
    bool "Rockchip RK805/RK806/RK817 PMIC power key support"
    depends on RT_INPUT_MISC
    default n
```

## components/drivers/input/touchscreen/Kconfig
```kconfig
menuconfig RT_INPUT_TOUCHSCREEN
    bool "Touchscreens"
    select RT_USING_TOUCH
    default n

config RT_INPUT_TOUCHSCREEN_RASPBERRYPI_FW
    bool "Raspberry Pi's firmware base touch screen support"
    depends on RT_INPUT_TOUCHSCREEN
    select RT_USING_OFW
    select RT_USING_DMA
    select RT_FIRMWARE_RASPBERRYPI
    select RT_USING_ADT
    select RT_USING_ADT_BITMAP
    default n
```

## components/drivers/mailbox/Kconfig
```kconfig
menuconfig RT_USING_MBOX
    bool "Using Hardware Mailbox device drivers"
    depends on RT_USING_DM
    select RT_USING_OFW
    default n

config RT_MBOX_BCM2835
    bool "BCM2835 Mailbox"
    depends on RT_USING_MBOX
    default n

config RT_MBOX_ROCKCHIP
    bool "Rockchip Soc Integrated Mailbox Support"
    depends on RT_USING_MBOX
    default n
```

## components/drivers/mfd/Kconfig
```kconfig
menuconfig RT_USING_MFD
    bool "Using Multifunction device drivers"
    depends on RT_USING_DM
    default n

config RT_MFD_BCM2835_PM
    bool "BCM2835 PM driver"
    depends on RT_USING_MFD
    default n

config RT_MFD_EDU
    bool "Educational device driver"
    depends on RT_USING_MFD
    select RT_USING_PCI
    select RT_USING_DMA
    default n

config RT_MFD_SYSCON
    bool "System Controller Register R/W"
    depends on RT_USING_MFD
    select RT_USING_OFW
    default y

config RT_MFD_RK8XX
    bool
    depends on RT_USING_MFD
    select RT_USING_PIC
    default n

config RT_MFD_RK8XX_I2C
    bool "Rockchip RK805/RK808/RK809/RK817/RK818 Power Management Chip"
    depends on RT_USING_MFD
    select RT_MFD_RK8XX
    select RT_USING_OFW
    select RT_USING_I2C
    select RT_MFD_SYSCON
    default n

config RT_MFD_RK8XX_SPI
    bool "Rockchip RK806 Power Management Chip"
    depends on RT_USING_MFD
    select RT_MFD_RK8XX
    select RT_USING_OFW
    select RT_USING_SPI
    select RT_MFD_SYSCON
    default n
```

## components/drivers/mtd/Kconfig
```kconfig
source "$RTT_DIR/components/drivers/mtd/Kconfig.nand"
source "$RTT_DIR/components/drivers/mtd/Kconfig.nor"
```

## components/drivers/mtd/Kconfig.nand
```kconfig
menuconfig RT_USING_MTD_NAND
    bool "Using MTD Nand Flash device drivers"
    default n

    if RT_USING_MTD_NAND
    config RT_MTD_NAND_DEBUG
        bool "Enable MTD Nand operations debug information"
        default n
    endif
```

## components/drivers/mtd/Kconfig.nor
```kconfig
menuconfig RT_USING_MTD_NOR
    bool "Using MTD Nor Flash device drivers"
    default n

config RT_USING_MTD_NOR_CFI
    bool "CFI Flash driver"
    depends on RT_USING_MTD_NOR
    depends on RT_USING_DM
    default n
```

## components/drivers/nvmem/Kconfig
```kconfig
menuconfig RT_USING_NVMEM
    bool "Using Non Volatile Memory (NVMEM) device drivers"
    depends on RT_USING_DM
    select RT_USING_OFW
    default n

config RT_NVMEM_ROCKCHIP_OTP
    bool "Rockchip OTP controller support"
    depends on RT_USING_NVMEM
    default n
```

## components/drivers/ofw/Kconfig
```kconfig
menuconfig RT_USING_OFW
    bool "Using Open Firmware (OFW)"
    depends on RT_USING_DM
    select RT_USING_ADT
    select RT_USING_ADT_REF
    select RT_USING_ADT_BITMAP
    select RT_USING_PIC
    default n

config RT_USING_BUILTIN_FDT
    bool "Using builtin fdt in kernel"
    depends on RT_USING_OFW
    default n

config RT_BUILTIN_FDT_PATH
    string "Builtin fdt path, will rebuild if have dts"
    depends on RT_USING_BUILTIN_FDT
    default "rtthread.dtb"

config RT_FDT_EARLYCON_MSG_SIZE
    int "Earlycon message buffer size (KB)"
    depends on RT_USING_OFW
    default 128

config RT_USING_OFW_DIRECTFS
    bool "Export fdt in direct access"
    depends on RT_USING_OFW
    select RT_USING_DFS
    select RT_USING_DFS_DIRECTFS
    default n

config RT_USING_OFW_BUS_RANGES_NUMBER
    int "Max bus ranges number"
    depends on RT_USING_OFW
    default 8 if ARCH_CPU_64BIT
    default 4
```

## components/drivers/pci/Kconfig
```kconfig
menuconfig RT_USING_PCI
    bool "Using Peripheral Component Interconnect Express (PCIe/PCI)"
    depends on RT_USING_DM
    depends on RT_USING_PIC
    default n

config RT_PCI_MSI
    bool "MSI/MSI-X"
    depends on RT_USING_PCI
    default y

config RT_PCI_SYS_64BIT
    bool "System 64bit"
    depends on RT_USING_PCI
    depends on ARCH_CPU_64BIT
    default y

config RT_PCI_CACHE_LINE_SIZE
    int "Cache line size"
    depends on RT_USING_PCI
    default 8 if ARCH_CPU_64BIT
    default 4

config RT_PCI_LOCKLESS
    bool "Lock less in PCI options"
    depends on RT_USING_PCI
    default n

config RT_PCI_ECAM
    bool "PCIe ECAM"
    depends on RT_USING_PCI
    default y
    help
        PCIe Express Enhanced Configuration Access Mechanism

source "$RTT_DIR/components/drivers/pci/host/Kconfig"
```

## components/drivers/pci/host/Kconfig
```kconfig
config RT_PCI_HOST_COMMON
    bool "Common PCI host controller"
    depends on RT_PCI_ECAM
    default y

config RT_PCI_HOST_GENERIC
    bool "Generic PCI host controller"
    depends on RT_PCI_ECAM
    select RT_PCI_HOST_COMMON
    default y

config RT_PCIE_BRCMSTB
    bool "Broadcom Brcmstb PCIe controller"
    depends on RT_PCI_MSI
    depends on RT_USING_OFW
    default n

config RT_PCIE_ROCKCHIP
    bool "Rockchip PCIe controller"
    depends on RT_USING_OFW
    depends on RT_USING_CLK
    depends on RT_USING_PIN
    depends on RT_USING_PINCTRL
    depends on RT_USING_RESET
    depends on RT_USING_REGULATOR
    depends on RT_USING_PHYE
    default n

config RT_PCIE_ROCKCHIP_EP
    bool "Rockchip PCIe endpoint"
    depends on RT_PCI_ENDPOINT
    depends on RT_USING_OFW
    depends on RT_USING_CLK
    depends on RT_USING_PIN
    depends on RT_USING_PINCTRL
    depends on RT_USING_RESET
    depends on RT_USING_REGULATOR
    depends on RT_USING_PHYE
    default n

source "$RTT_DIR/components/drivers/pci/host/dw/Kconfig"
```
