## components/drivers/pci/host/dw/Kconfig
```kconfig
config RT_PCI_DW_HOST
    bool "DesignWare-based PCIe host"
    depends on RT_USING_PCI
    default n

config RT_PCI_DW_HOST_ROCKCHIP
    bool "Rockchip DesignWare PCIe host"
    depends on RT_PCI_DW_HOST
    select RT_USING_PHY
    select RT_USING_RESET
    select RT_MFD_SYSCON
    select RT_USING_REGULATOR
    default n
```

## components/drivers/phy/Kconfig
```kconfig
menuconfig RT_USING_PHY
    bool "Using Port Physical Layer (PHY) device drivers"
    default n

if RT_USING_DM && RT_USING_PHY
source "$RTT_DIR/components/drivers/phy/rockchip/Kconfig"
endif
```

## components/drivers/phy/rockchip/Kconfig
```kconfig
config RT_PHY_ROCKCHIP_NANENG_COMBO
    bool "Rockchip NANENG COMBO PHY Driver"
    select RT_MFD_SYSCON
    default n

config RT_PHY_ROCKCHIP_SNPS_PCIE3
    bool "Rockchip Snps PCIe3 PHY Driver"
    select RT_MFD_SYSCON
    default n
```

## components/drivers/pic/Kconfig
```kconfig
menuconfig RT_USING_PIC
    bool "Using Programmable Interrupt Controller (PIC)"
    select RT_USING_BITMAP
    depends on RT_USING_DM
    default n

config MAX_HANDLERS
    int "IRQ max handlers"
    depends on RT_USING_PIC
    range 1 2147483647
    default 256

config RT_PIC_ARM_GIC
    bool "ARM GICv2/v1"
    depends on RT_USING_PIC
    depends on RT_USING_OFW
    default n

config RT_PIC_ARM_GIC_V2M
    bool "ARM GIC V2M" if RT_PIC_ARM_GIC && RT_PCI_MSI
    depends on RT_USING_OFW
    select RT_USING_ADT_BITMAP
    default n

config RT_PIC_ARM_GIC_V3
    bool "ARM GICv3"
    depends on RT_USING_PIC
    depends on RT_USING_OFW
    default n

config RT_PIC_ARM_GIC_V3_ITS
    bool "ARM GICv3 ITS (Interrupt Translation Service)" if RT_PIC_ARM_GIC_V3 && RT_PCI_MSI
    depends on RT_USING_OFW
    select RT_USING_ADT_REF
    select RT_USING_ADT_BITMAP
    default n

config RT_PIC_ARM_GIC_MAX_NR
    int
    depends on RT_USING_PIC
    depends on RT_PIC_ARM_GIC
    default 2 if SOC_REALVIEW
    default 1
```

## components/drivers/pin/Kconfig
```kconfig
menuconfig RT_USING_PIN
    bool "Using Generic GPIO device drivers"
    default y

config RT_PIN_PL061
    bool "ARM PL061"
    depends on RT_USING_DM
    depends on RT_USING_PIN
    default n
```

## components/drivers/pinctrl/Kconfig
```kconfig
menuconfig RT_USING_PINCTRL
    bool "Using Pin controllers device drivers"
    depends on RT_USING_DM
    depends on RT_USING_PIN
    default n

config RT_PINCTRL_ROCKCHIP
    bool "Rockchip gpio and pinctrl driver"
    depends on RT_USING_PINCTRL
    select RT_MFD_SYSCON
    default n

config RT_PINCTRL_ROCKCHIP_RK8XX
    bool "Pinctrl and GPIO driver for RK805/RK806 PMIC"
    depends on RT_USING_PINCTRL
    depends on RT_MFD_RK8XX
    default n
```

## components/drivers/pm/Kconfig
```kconfig
menuconfig RT_USING_PM
    bool "Using Power Management device drivers"
    default n

    if RT_USING_PM
        config PM_TICKLESS_THRESHOLD_TIME
            int "PM tickless threashold time"
            default 2

        config PM_USING_CUSTOM_CONFIG
            bool "PM using custom pm config"
            default n

        config PM_ENABLE_DEBUG
            bool "PM Enable Debug"
            default n

        config PM_ENABLE_SUSPEND_SLEEP_MODE
            bool "PM Device suspend change sleep mode"
            default n

        config PM_ENABLE_THRESHOLD_SLEEP_MODE
            bool "PM using threshold time change sleep mode"
            default n

        if PM_ENABLE_THRESHOLD_SLEEP_MODE
            config PM_LIGHT_THRESHOLD_TIME
                int "PM light mode threashold time"
                default 5

            config PM_DEEP_THRESHOLD_TIME
                int "PM deep mode threashold time"
                default 20

            config PM_STANDBY_THRESHOLD_TIME
                int "PM standby mode threashold time"
                default 100
        endif
    endif

config RT_PM_RESET_SYSCON
    bool "Generic SYSCON regmap reset driver"
    depends on RT_USING_PM
    depends on RT_USING_OFW
    select RT_MFD_SYSCON

config RT_PM_RESET_SYSCON_POWEROFF
    bool "Generic SYSCON regmap poweroff driver"
    depends on RT_USING_PM
    depends on RT_USING_OFW
    select RT_MFD_SYSCON
```

## components/drivers/pmdomain/Kconfig
```kconfig
if RT_USING_DM
menu "Power Management (PM) Domains device drivers"

endmenu
endif
```

## components/drivers/power/Kconfig
```kconfig
source "$RTT_DIR/components/drivers/power/reset/Kconfig"
source "$RTT_DIR/components/drivers/power/supply/Kconfig"
```

## components/drivers/power/reset/Kconfig
```kconfig
menuconfig RT_USING_POWER_RESET
    bool "Using Board level reset or power off"
    depends on RT_USING_DM

config RT_POWER_RESET_SYSCON_POWEROFF
    bool "Generic SYSCON regmap poweroff driver"
    depends on RT_USING_POWER_RESET
    select RT_MFD_SYSCON

config RT_POWER_RESET_SYSCON_REBOOT_MODE
    bool "Generic SYSCON regmap reboot mode driver"
    depends on RT_USING_POWER_RESET
    select RT_MFD_SYSCON
    select RT_POWER_RESET_REBOOT_MODE

config RT_POWER_RESET_SYSCON_REBOOT
    bool "Generic SYSCON regmap reboot driver"
    depends on RT_USING_POWER_RESET
    select RT_MFD_SYSCON

config RT_POWER_RESET_REBOOT_MODE
    bool
    select RT_USING_OFW
```

## components/drivers/power/supply/Kconfig
```kconfig
menuconfig RT_USING_POWER_SUPPLY
    bool "Using Power supply class support"
    depends on RT_USING_DM
```

## components/drivers/pwm/Kconfig
```kconfig
menuconfig RT_USING_PWM
    bool "Using PWM device drivers"
    default n

config RT_PWM_BCM2835
    bool "BCM2835 PWM support"
    select RT_USING_PINCTRL
    depends on RT_USING_DM
    depends on RT_USING_PWM
    default n

config RT_PWM_BRCMSTB
    bool "Broadcom STB PWM support"
    select RT_USING_PINCTRL
    depends on RT_USING_DM
    depends on RT_USING_PWM
    default n

config RT_PWM_ROCKCHIP
    bool "Rockchip PWM support"
    select RT_USING_PINCTRL
    depends on RT_USING_DM
    depends on RT_USING_PWM
    default n

config RT_PWM_RP1
    bool "RP1 PWM support"
    select RT_USING_PINCTRL
    depends on RT_USING_DM
    depends on RT_USING_PWM
    default n
```

## components/drivers/regulator/Kconfig
```kconfig
menuconfig RT_USING_REGULATOR
    bool "Using Voltage and Current Regulator"
    depends on RT_USING_DM
    default n

config RT_REGULATOR_FAN53555
    bool "Fairchild FAN53555 Regulator"
    depends on RT_USING_REGULATOR
    depends on RT_USING_I2C
    default n

config RT_REGULATOR_FIXED
    bool "Fixed regulator support"
    depends on RT_USING_REGULATOR
    select RT_USING_PIN
    default y

config RT_REGULATOR_GPIO
    bool "GPIO regulator support"
    depends on RT_USING_REGULATOR
    select RT_USING_PIN
    default y

config RT_REGULATOR_PWM
    bool "PWM regulator support"
    depends on RT_USING_REGULATOR
    select RT_USING_PWM
    select RT_USING_PIN
    select RT_USING_OFW
    default n

config RT_REGULATOR_RK8XX
    bool "Rockchip RK805/RK808/RK809/RK817/RK818 Power regulators"
    depends on RT_USING_REGULATOR
    depends on RT_MFD_RK8XX
    select RT_USING_PIN
    default y

config RT_REGULATOR_SCMI
    bool "SCMI regulator support"
    depends on RT_USING_REGULATOR
    select RT_USING_OFW
    select RT_FIRMWARE_ARM_SCMI
    default n
```

## components/drivers/reset/Kconfig
```kconfig
menuconfig RT_USING_RESET
    bool "Using Reset Controller support"
    depends on RT_USING_DM
    select RT_USING_OFW
    default n

config RT_RESET_BRCMSTB_RESCAL
    bool "Broadcom STB RESCAL reset controller"
    depends on RT_USING_RESET
    default n

config RT_RESET_BRCMSTB
    bool "Broadcom STB reset controller"
    depends on RT_USING_RESET
    default n

config RT_RESET_RASPBERRYPI
    bool "Raspberry Pi 4 Firmware Reset Driver"
    depends on RT_USING_RESET
    select RT_FIRMWARE_RASPBERRYPI
    default n

config RT_RESET_SCMI
    bool "Reset driver controlled via ARM SCMI interface"
    depends on RT_USING_RESET
    depends on RT_FIRMWARE_ARM_SCMI
    default n
```

## components/drivers/rtc/Kconfig
```kconfig
menuconfig RT_USING_RTC
    bool "Using Real Time Clock (RTC) device drivers"
    default n

    if RT_USING_RTC
        config RT_USING_ALARM
            bool "Using RTC alarm"
            default n

        config RT_USING_SOFT_RTC
            bool "Using software simulation RTC device"
            default n
    endif

config RT_RTC_PL031
    bool "ARM PL031"
    depends on RT_USING_DM
    depends on RT_USING_RTC
    default n
```

## components/drivers/sdio/host/Kconfig
```kconfig
config RT_SDIO_SDHCI_DWCMSHC
    bool "Synopsys DWC MSHC SDHCI"
    select RT_USING_OFW
    default n

config RT_SDIO_DW_MMC
    bool "Synopsys DesignWare MMC Family"
    select RT_USING_PINCTRL
    select RT_USING_RESET
    select RT_USING_REGULATOR
    select RT_USING_DEVICE_IPC
    select RT_USING_SYSTEM_WORKQUEUE
    default n

config RT_SDIO_DW_MMC_PCI
    bool "Synopsys Designware MCI support on PCI bus"
    depends on RT_SDIO_DW_MMC
    select RT_USING_PCI
    default n

config RT_SDIO_DW_MMC_ROCKCHIP
    bool "Rockchip"
    depends on RT_SDIO_DW_MMC
    select RT_USING_OFW
    default n
```

## components/drivers/serial/8250/Kconfig
```kconfig
menuconfig RT_SERIAL_8250
    bool "8250 Serila Family"
    default n

config RT_SERIAL_8250_BCM2835AUX
    bool "BCM2835 auxiliar mini UART"
    depends on RT_SERIAL_8250
    default n

config RT_SERIAL_8250_BCM7271
    bool "Broadcom 8250 based serial port"
    depends on RT_SERIAL_8250
    select RT_USING_DMA
    select RT_SERIAL_USING_DMA
    default n

config RT_SERIAL_8250_DW
    bool "Synopsys DesignWare 8250"
    depends on RT_SERIAL_8250
    default n

config RT_SERIAL_8250_OFW
    bool "8250 Platform"
    depends on RT_SERIAL_8250
    select RT_USING_OFW
    select RT_USING_RESET
    default n

config RT_SERIAL_8250_PCI
    bool "8250 PCI/2x/4x"
    depends on RT_SERIAL_8250
    select RT_USING_PCI
    default n
```

## components/drivers/serial/virtual/Kconfig
```kconfig
menuconfig RT_SERIAL_VIRTUAL
    bool "Virtual Serial in video"
    select RT_VIDEO_FB
    select RT_INPUT_KEYBOARD
    default n

config RT_SERIAL_VIRTUAL_FBDEV
    string "framebuffer device"
    default "fb0"

config RT_SERIAL_VIRTUAL_KDBDEV
    string "keyboard device"
    default "kdb0"

choice
    prompt "Rendering font(psf)"
    default RT_SERIAL_VIRTUAL_FONT_UNI2_FIXED16
    depends on RT_SERIAL_VIRTUAL

    config RT_SERIAL_VIRTUAL_FONT_UNI2_FIXED16
        bool "uni2 fixed16"

    config RT_SERIAL_VIRTUAL_FONT_UNI2_VGA16
        bool "uni2 vga16"
endchoice
```

## components/drivers/soc/Kconfig
```kconfig
menuconfig RT_USING_SOC
    bool "Using SOC (System On Chip) specific Drivers"
    depends on RT_USING_DM
    default n

if RT_USING_SOC
    source "$RTT_DIR/components/drivers/soc/broadcom/Kconfig"
    source "$RTT_DIR/components/drivers/soc/rockchip/Kconfig"
endif
```

## components/drivers/soc/broadcom/Kconfig
```kconfig
menuconfig RT_SOC_BROADCOM
    bool "Broadcom"
    default n

if RT_SOC_BROADCOM
config RT_SOC_BROADCOM_RASPBERRYPI_VOLTAGE_MONITOR
    bool "Raspberry Pi voltage monitor"
    select RT_FIRMWARE_RASPBERRYPI
    default n
endif
```

## components/drivers/soc/rockchip/Kconfig
```kconfig
menuconfig RT_SOC_ROCKCHIP
    bool "RockChip"
    default n

if RT_SOC_ROCKCHIP
config RT_SOC_ROCKCHIP_FIQ_DEBUGGER
    bool "FIQ Debugger"
    select RT_USING_OFW
    default y

config RT_SOC_ROCKCHIP_GRF
    bool "General Register Files support"
    select RT_MFD_SYSCON
    default y

config RT_SOC_ROCKCHIP_HW_DECOMPRESS
    bool "HardWare Decompress (LZ4, GZIP, ZLIB)"
    default y

config RT_SOC_ROCKCHIP_IODOMAIN
    bool "IO domain support"
    select RT_MFD_SYSCON
    select RT_USING_REGULATOR
    default y
endif
```

## components/drivers/thermal/Kconfig
```kconfig
menuconfig RT_USING_THERMAL
    bool "Using Thermal Management device drivers"
    depends on RT_USING_DM
    default n

config RT_THERMAL_BCM2835
    bool "Thermal sensors on bcm2835 SoC"
    depends on RT_USING_DM
    depends on RT_USING_THERMAL
    default n

config RT_THERMAL_BCM2711
    bool "Thermal sensors on bcm2711 SoC"
    depends on RT_USING_DM
    depends on RT_USING_THERMAL
    select RT_MFD_SYSCON
    select RT_USING_RESET
    default n

config RT_THERMAL_ROCKCHIP_TSADC
    bool "Rockchip TS-ADC driver"
    depends on RT_USING_DM
    depends on RT_USING_THERMAL
    select RT_MFD_SYSCON
    select RT_USING_RESET
    default n
```

## components/drivers/video/Kconfig
```kconfig
config RT_USING_LCD
    bool "Using LCD graphic drivers" if !RT_USING_DM
    default n

menuconfig RT_USING_VIDEO
    bool "Using Video Graphics device drivers"
    default n

if RT_USING_VIDEO
source "$RTT_DIR/components/drivers/video/logo/Kconfig"
endif
```

## components/drivers/video/backlight/Kconfig
```kconfig
menuconfig RT_VIDEO_BACKLIGHT
    bool "Backlight support"
    depends on RT_USING_VIDEO
    default n

config RT_VIDEO_BACKLIGHT_GPIO
    bool "Generic GPIO based backlight driver"
    depends on RT_VIDEO_BACKLIGHT
    select RT_USING_PIN
    default n

config RT_VIDEO_BACKLIGHT_PWM
    bool "Generic PWM based backlight driver"
    depends on RT_VIDEO_BACKLIGHT
    select RT_USING_OFW
    select RT_USING_PIN
    select RT_USING_PWM
    select RT_USING_REGULATOR
    default n

config RT_VIDEO_BACKLIGHT_RPI
    bool "Raspberry Pi display firmware driven backlight"
    depends on RT_VIDEO_BACKLIGHT
    select RT_FIRMWARE_RASPBERRYPI
    default n
```

## components/drivers/video/framebuffer/Kconfig
```kconfig
menuconfig RT_VIDEO_FB
    bool "LCD and Frame buffer support"
    depends on RT_USING_VIDEO
    select RT_USING_LCD
    default y

config RT_VIDEO_FB_SIMPLE
    bool "Simple framebuffer support"
    depends on RT_VIDEO_FB
    select RT_USING_OFW
    default y
```
