## components/drivers/video/logo/Kconfig
```kconfig
menuconfig RT_VIDEO_LOGO
    bool "Startup Logo"
    depends on RT_USING_VIDEO
    default y

config RT_VIDEO_LOGO_FBDEV
    string "framebuffer device"
    default "fb0"

choice
    prompt "Rendering stage"
    default RT_VIDEO_LOGO_RENDERING_STAGE_DRIVER_EARLY
    depends on RT_VIDEO_LOGO

    config RT_VIDEO_LOGO_RENDERING_STAGE_DRIVER_EARLY
        bool "Device driver early"

    config RT_VIDEO_LOGO_RENDERING_STAGE_DRIVER
        bool "Device driver"

    config RT_VIDEO_LOGO_RENDERING_STAGE_DRIVER_LATER
        bool "Device driver later"

    config RT_VIDEO_LOGO_RENDERING_STAGE_COMPONENT
        bool "Components"

    config RT_VIDEO_LOGO_RENDERING_STAGE_ENV
        bool "Environment"

    config RT_VIDEO_LOGO_RENDERING_STAGE_APP
        bool "Application"
endchoice

choice
    prompt "Rendering image(ppm)"
    default RT_VIDEO_LOGO_RT_THREAD_CLUT224
    depends on RT_VIDEO_LOGO

    config RT_VIDEO_LOGO_RT_THREAD_CLUT224
        bool "Standard 224-color RT-Thread logo"

    config RT_VIDEO_LOGO_RT_THREAD_WHITE_CLUT224
        bool "Standard 224-color RT-Thread white logo"

    config RT_VIDEO_LOGO_BSP
        bool "BSP customized logo"
endchoice

config RT_VIDEO_LOGO_BSP_PATH
    string "Rendering image(ppm) BSP customized logo path"
    depends on RT_VIDEO_LOGO_BSP
    default "logo_bsp.ppm"
```

## components/drivers/virtio/Kconfig
```kconfig
menuconfig RT_USING_VIRTIO
    bool "Using VirtIO device drivers"
    depends on RT_USING_DM
    default n

config RT_VIRTIO_TRANSPORT_MMIO
    bool "Using VirtIO MMIO transport"
    depends on RT_USING_VIRTIO
    select RT_USING_OFW
    default y

config RT_VIRTIO_TRANSPORT_PCI
    bool "Using VirtIO PCI transport"
    depends on RT_USING_VIRTIO
    select RT_USING_PCI
    default y

config RT_VIRTIO_NET
    bool "VirtIO Net"
    depends on RT_USING_VIRTIO
    select RT_USING_LWIP
    default y

config RT_VIRTIO_BLK
    bool "VirtIO BLK"
    depends on RT_USING_VIRTIO
    select RT_USING_BLK
    default y

config RT_VIRTIO_CONSOLE
    bool "VirtIO Console"
    depends on RT_USING_VIRTIO
    default y

config RT_VIRTIO_RNG
    bool "VirtIO RNG"
    depends on RT_USING_VIRTIO
    select RT_USING_HWCRYPTO
    select RT_HWCRYPTO_USING_RNG
    default y

config RT_VIRTIO_GPU
    bool "VirtIO GPU"
    depends on RT_USING_VIRTIO
    default y

config RT_VIRTIO_INPUT
    bool "VirtIO Input"
    depends on RT_USING_VIRTIO
    default y

config RT_VIRTIO_SOUND
    bool "VirtIO Sound"
    depends on RT_USING_VIRTIO
    select RT_USING_AUDIO
    default y
```

## components/drivers/watchdog/Kconfig
```kconfig
menuconfig RT_USING_WDT
    bool "Using Watch Dog device drivers"
    default n

config RT_WDT_I6300ESB
    bool "Intel 6300ESB Timer/Watchdog"
    depends on RT_USING_DM
    depends on RT_USING_WDT
    depends on RT_USING_PCI
```
