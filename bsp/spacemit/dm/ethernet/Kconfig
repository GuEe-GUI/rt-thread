## bsp/spacemit/dm/ethernet/Kconfig
```kconfig
config RT_ETHERNET_K1X_EMAC
    bool "Spacemit k1x Emac devices"
    select RT_USING_PTP
    default y
```

## bsp/spacemit/dm/soc/Kconfig
```kconfig
config RT_SOC_SPACEMIT_K1X_RPROC
    bool "Spacemit k1x remoteproc Driver"
    default y

config RT_SOC_CHIP_MEDIA_JPU
    bool "Chip media JPU Driver"
    default n

config RT_SOC_SPACEMIT_V2D
    bool "Spacemit V2D Engine Driver"
    default n

config RT_SOC_SPACEMIT_K1X_TCM
    bool "Spacemit k1x generic TCM alloc management Driver"
    depends on RT_USING_MEMHEAP
    default n

config RT_SOC_SPACEMIT_SOCINFO
    bool "Spacemit SoC information Driver"
    depends on RT_USING_NVMEM
    default n
```

## components/drivers/Kconfig
```kconfig
menu "Device Drivers"

rsource "core/Kconfig"
rsource "ipc/Kconfig"

rsource "serial/Kconfig"
rsource "can/Kconfig"
rsource "cputime/Kconfig"
rsource "i2c/Kconfig"
rsource "phy/Kconfig"
rsource "misc/Kconfig"
rsource "mtd/Kconfig"
rsource "pm/Kconfig"
rsource "rtc/Kconfig"
rsource "sdio/Kconfig"
rsource "spi/Kconfig"
rsource "watchdog/Kconfig"
rsource "audio/Kconfig"
rsource "sensor/Kconfig"
rsource "touch/Kconfig"
rsource "graphic/Kconfig"
rsource "hwcrypto/Kconfig"
rsource "wlan/Kconfig"
rsource "ethernet/Kconfig"
rsource "led/Kconfig"
rsource "input/Kconfig"
rsource "mailbox/Kconfig"
rsource "hwspinlock/Kconfig"
rsource "rpmsg/Kconfig"
rsource "phye/Kconfig"
rsource "ata/Kconfig"
rsource "nvme/Kconfig"
rsource "block/Kconfig"
rsource "scsi/Kconfig"
rsource "ufs/Kconfig"
rsource "firmware/Kconfig"
rsource "hwcache/Kconfig"
rsource "dvfs/Kconfig"
rsource "regulator/Kconfig"
rsource "reset/Kconfig"
rsource "pmdomain/Kconfig"
rsource "power/Kconfig"
rsource "thermal/Kconfig"
rsource "ptp/Kconfig"
rsource "virtio/Kconfig"
rsource "nvmem/Kconfig"
rsource "tee/Kconfig"
rsource "dma/Kconfig"
rsource "iommu/Kconfig"
rsource "mfd/Kconfig"
rsource "ivshmem/Kconfig"
rsource "ofw/Kconfig"
rsource "pci/Kconfig"
rsource "pic/Kconfig"
rsource "pinctrl/Kconfig"
rsource "pin/Kconfig"
rsource "ktime/Kconfig"
rsource "clk/Kconfig"
rsource "hwtimer/Kconfig"
rsource "usb/Kconfig"

if RT_USING_DM
    menu "SoC (System on Chip) Drivers"
        osource "$(SOC_DM_SOC_DIR)/Kconfig"
    endmenu
endif

endmenu
```

## components/drivers/ethernet/cadence/Kconfig
```kconfig
config RT_ETHERNET_CADENCE
    bool "Cadence"

config RT_ETHERNET_CADENCE_PCI
    bool "PCI supported"
    depends on RT_ETHERNET_CADENCE
    depends on RT_USING_PCI

config RT_ETHERNET_CADENCE_PTP
    bool "PTP supported"
    depends on RT_ETHERNET_CADENCE
    depends on RT_USING_PTP
```

## components/drivers/ethernet/realtek/Kconfig
```kconfig
config RT_ETHERNET_REALTEK
    bool "Realtek"
    depends on RT_USING_PCI

config RT_REALTEK_PTP
    bool "PTP supported"
    depends on RT_ETHERNET_REALTEK
    depends on RT_USING_PTP
```

## components/drivers/iommu/Kconfig
```kconfig
menuconfig RT_USING_IOMMU
    bool "Using I/O memory management unit (IOMMU)"
    depends on RT_USING_DM
    depends on ARCH_MM_MMU
    select RT_USING_ADT
    select RT_USING_ADT_REF
    default n
    help
      Compared with DMA, IOMMU has the following advantages:
        - Large regions of memory can be allocated without the need to be contiguous
          in physical memory. The IOMMU maps contiguous virtual addresses (VAs) to
          the fragmented PAs.
        - Devices that do not support memory addresses long enough to address the
          entire physical memory can still address the entire memory through the
          IOMMU. For example, x86 computers can address more than 4 GB of memory with
          the Physical Address Extension (PAE) feature. But an ordinary 32-bit PCI
          device cannot address the memory above 4 GB. With IOMMU, the device can
          address the entire physical memory.
        - Memory is protected from malicious devices that are attempting DMA attacks
          and faulty devices that are attempting errant memory transfers because a
          device cannot read or write to the mapped physical memory.
        - In virtualization, a guest OS can use hardware that is not specifically made
          for virtualization. Higher performance hardware such as graphics cards uses
          DMA to access memory directly. In a virtual environment, all memory addresses
          are re-mapped by the virtualization software (such as QEMU), which causes
          the guest OS fails to access memory using DMA. The IOMMU handles this
          re-mapping, allowing the drivers to use DMA to access memory in the guest OS.
        - In some architectures IOMMU also performs interrupt re-mapping, in a manner
          similar to address re-mapping.
        - Peripheral memory paging can be supported by an IOMMU. A peripheral using
          the PCI-SIG PCIe Address Translation Services (ATS) Page Request Interface
          (PRI) extension can detect and signal the need for memory manager services.

config RT_IOMMU_SMMUV3
    bool "ARM SMMUv3"
    depends on RT_USING_IOMMU
    default y

if RT_USING_IOMMU
    osource "$(SOC_DM_IOMMU_DIR)/Kconfig"
endif
```
